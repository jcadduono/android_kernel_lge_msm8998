/* Copyright (c) 2014, The Linux Foundation. All rights reserved.
 *
 * This program is free software; you can redistribute it and/or modify
 * it under the terms of the GNU General Public License version 2 and
 * only version 2 as published by the Free Software Foundation.
 *
 * This program is distributed in the hope that it will be useful,
 * but WITHOUT ANY WARRANTY; without even the implied warranty of
 * MERCHANTABILITY or FITNESS FOR A PARTICULAR PURPOSE.  See the
 * GNU General Public License for more details.
 */

&i2c_5 {
	status = "okay";
	qcom,clk-freq-out = <400000>;

	qcom,use-bam;
	qcom,bam-consumer-pipe-index = <14>;
	qcom,bam-producer-pipe-index = <15>;

	stm_ftm4@49 {
		status = "ok";
		compatible = "stm,ftm4";

		reg = <0x49>;
		interrupt-parent = <&tlmm>;
		interrupts = <125 0x2008>;
		irqflags = <0x00000002>;

		pinctrl-names = "touch_pin_active", "touch_pin_sleep";
		pinctrl-0 = <&ts_ftm4_vdd_en_active &ts_ftm4_vio_en_active &ts_ftm4_reset_active &ts_ftm4_int_active>;
		pinctrl-1 = <&ts_ftm4_vdd_en_suspend &ts_ftm4_vio_en_suspend &ts_ftm4_reset_suspend &ts_ftm4_int_suspend>;

		vdd-gpio = <&tlmm 85 0x00>;
		vio-gpio = <&tlmm 86 0x00>;
		reset-gpio = <&tlmm 89 0x00>;
		ta_detect-gpio = <&tlmm 91 0x00>;
		irq-gpio = <&tlmm 125 0x2008>;

		/* Caps */
		max_x = <1439>;
		max_y = <2879>;
		max_pressure = <0xff>;
		max_width_major = <2879>;
		max_width_minor = <2879>;
		max_orientation = <90>;
		max_id = <10>;
		hw_reset_delay = <10>;
		sw_reset_delay = <10>;

		/* Role */
		use_lpwg = <1>;
		use_lpwg_test = <1>;
		hide_coordinate = <1>;

		/* Firmware */
		fw_image = "touch/joan/L0S59P1_1_08.ftb";
		panel_spec = "touch/joan/joan_limit.txt";
		panel_spec_mfts_folder = "touch/joan/joan_limit_mfts.txt";
	};

	ftm4_fts@49 {
		status = "disabled";
		compatible = "stm,ftm4_fts";
		reg = <0x49>;

		pinctrl-names = "on_state","off_state";
		pinctrl-0 = <&ts_active>;
		pinctrl-1 = <&ts_suspend>;

		stm,irq_gpio = <&tlmm 125 0>;
		stm,irq_type = <0x2008>;
		stm,num_lines = <32 16>;
		stm,max_coords = <1440 2880>;
		//stm,regulator_dvdd = "tsp_io";
		//stm,regulator_avdd = "tsp_avdd";
		//stm,tspid_gpio = <&gpg1 4 0>;
		//stm,tspid2_gpio = <&gpr3 2 0>;

		stm,vdd-gpio = <&tlmm 85 0x0>;
		stm,vio-gpio = <&tlmm 86 0x0>;

		stm,firmware_name = "touch/joan/L0S59P1_1_08.ftb";
	};
};
