/* Copyright (c) 2016, The Linux Foundation. All rights reserved.
 *
 * This program is free software; you can redistribute it and/or modify
 * it under the terms of the GNU General Public License version 2 and
 * only version 2 as published by the Free Software Foundation.
 *
 * This program is distributed in the hope that it will be useful,
 * but WITHOUT ANY WARRANTY; without even the implied warranty of
 * MERCHANTABILITY or FITNESS FOR A PARTICULAR PURPOSE.  See the
 * GNU General Public License for more details.
 */

#include "../../msm8998-joan/msm8998-joan-common/msm8998-joan-common-pm.dtsi"

&pmi8998_haptics {
	status = "okay";
};

&i2c_1 { /* BLSP1 QUP1 */
	idtp9223-charger@61 {               /* Slave driver and slave Address */
		idt,fod-register = <0x78>;
		idt,fod-value = <0xA7>;
	};
};

&soc {
};
