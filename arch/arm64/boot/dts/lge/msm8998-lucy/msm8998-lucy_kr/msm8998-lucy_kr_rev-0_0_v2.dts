/* Copyright (c) 2016, The Linux Foundation. All rights reserved.
 *
 * This program is free software; you can redistribute it and/or modify
 * it under the terms of the GNU General Public License version 2 and
 * only version 2 as published by the Free Software Foundation.
 *
 * This program is distributed in the hope that it will be useful,
 * but WITHOUT ANY WARRANTY; without even the implied warranty of
 * MERCHANTABILITY or FITNESS FOR A PARTICULAR PURPOSE.  See the
 * GNU General Public License for more details.
 */


/dts-v1/;

#include "../../../qcom/msm8998-v2.dtsi"
#include "msm8998-lucy_kr.dtsi"

/ {
	model = "Qualcomm Technologies, Inc. MSM8998 v2 MTP";
	compatible = "qcom,msm8998-mtp", "qcom,msm8998", "qcom,mtp";
	qcom,board-id = <0x308 0>;
};

&soc {
	sound-9335 {
		/* sabre amp */
		qcom,sabre-ldo-sw = <&pm8998_gpios 10 0x0>;
		qcom,sabre-hph-sw = <&pm8998_gpios 15 0x0>;
		qcom,sabre-amp-dpb = <&tlmm 42 0x0>;
	};
};

&pm8998_vadc {
	lge,gpio-sbu-sel = <&tlmm 78 0>;
};