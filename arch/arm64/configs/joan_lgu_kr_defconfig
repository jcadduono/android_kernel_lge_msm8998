## drivers/broadcast/Kconfig
```kconfig
# LGE Broadcast Device Driver Support

menu "LGE Broadcast Device Support"

config LGE_BROADCAST_TDMB
    bool "LGE broadcast TDMB device Driver"
    depends on (MACH_LGE)
    default n
    help
      Select this if you want to use TDMB broadcast service

source "drivers/broadcast/tdmb/Kconfig"
endmenu
```

## drivers/input/sensor/Kconfig
```kconfig
#
# Input misc drivers configuration
#
menuconfig INPUT_SENSOR
	bool "Sensor devices"
	help
	  Say Y here, and a list of Sensor input drivers will be displayed.
	  Everything that didn't fit into the other categories is here. This option
	  doesn't affect the kernel.

	  If unsure, say Y.

config USE_CAP_SENSOR
       bool "SX9320 support"
       depends on I2C
       help
         Support SX9320 as an input device.
```

## drivers/power/supply/qcom/Kconfig
```kconfig
menu "Qualcomm Technologies Inc Charger and Fuel Gauge support"

config QPNP_FG_GEN3
	tristate "QPNP GEN3 fuel gauge driver"
	depends on MFD_SPMI_PMIC
	help
	  Say Y here to enable the GEN3 Fuel Gauge driver. This adds support
	  for battery fuel gauging and state of charge of battery connected to
	  the fuel gauge. The state of charge is reported through a BMS power
	  supply property and also sends uevents when the capacity is updated.

config SMB135X_CHARGER
	tristate "SMB135X Battery Charger"
	depends on I2C
	help
	  Say Y to include support for SMB135X Battery Charger.
	  SMB135X is a dual path switching mode charger capable of charging
	  the battery with 3Amps of current.
	  The driver supports charger enable/disable.
	  The driver reports the charger status via the power supply framework.
	  A charger status change triggers an IRQ via the device STAT pin.

config SMB1351_USB_CHARGER
	tristate "smb1351 usb charger (with VBUS detection)"
	depends on I2C
	help
	 Say Y to enable support for the SMB1351 switching mode based charger.
	 The driver supports charging control (enable/disable) and
	 charge-current limiting. It also provides USB VBUS detection and
	 notification support. The driver controls SMB1351 via I2C and
	 supports device-tree interface.

config MSM_BCL_CTL
	bool "BCL Framework driver"
	help
	  Say Y here to enable this BCL Framework driver. This driver provides
	  interface, which can be used by the BCL h/w drivers to implement the
	  basic functionalities. This framework abstracts the underlying
	  hardware for the top level modules.

config MSM_BCL_PERIPHERAL_CTL
	bool "BCL driver to control the PMIC BCL peripheral"
	depends on SPMI
	depends on MSM_BCL_CTL
	help
	  Say Y here to enable this BCL PMIC peripheral driver. This driver
	  provides routines to configure and monitor the BCL
	  PMIC peripheral.

config BATTERY_BCL
	tristate "Battery Current Limit driver"
	depends on THERMAL_MONITOR
	help
	  Say Y here to enable support for battery current limit
	  device. The BCL driver will poll BMS if
	  thermal daemon enables BCL.
	  It will notify thermal daemon if IBat crosses Imax threshold.

config QPNP_SMB2
	tristate "SMB2 Battery Charger"
	depends on MFD_SPMI_PMIC
	help
	  Enables support for the SMB2 charging peripheral

config SMB138X_CHARGER
	tristate "SMB138X Battery Charger"
	depends on MFD_I2C_PMIC
	help
	  Say Y to include support for SMB138X Battery Charger.
	  SMB1380 is a dual phase 6A battery charger, and SMB1381 is a single
	  phase 5A battery charger.
	  The driver supports charger enable/disable.
	  The driver reports the charger status via the power supply framework.
	  A charger status change triggers an IRQ via the device STAT pin.

config BQ25898S_CHARGER
	tristate "TI BQ25898S battery charger driver"
	default n
	depends on MFD_I2C_PMIC
	help
	  Say Y to enable support for the TI BQ25898S battery charger.

config QPNP_QNOVO
	bool "QPNP QNOVO driver"
	depends on MFD_SPMI_PMIC
	help
	  Say Y here to enable the Qnovo pulse charging engine. Qnovo driver
	  accepts pulse parameters via sysfs entries and programs the hardware
	  module. It also allows userspace code to read diagnostics of voltage
	  and current measured during certain phases of the pulses.

config LGE_PM_DEBUG
	tristate "Support LGE PM Debug Feature"
	default n
	depends on MACH_LGE
	help
	  LGE PM Debug Feature

config LGE_PM_SOC_SCALING
	bool "Battery Capacity Scaling"
	depends on LGE_PM
	help
	  Say Y here to enable the battery capacity to be scaled.

config LGE_PM_BATTID_CONNECTED_GND
	bool "Fake batt ID"
	depends on LGE_PM
	help
	  Say Y only batt_id was directly connected to GND

config LGE_PM_FG_AGE
	tristate "QPNP FG battery age mode"
	depends on LGE_PM
	default n
	help
	 Say Y to enable to battery age mode for KDDI or DCM.
	 age value is 1 = very good condition
	 age value is 2 = good condition
	 age value is 3 = bad condition

config LGE_PM_CYCLE_BASED_CHG_VOLTAGE
	bool "LGE battery cycle based chg voltage change feature"
	default n
	depends on LGE_PM
	help
	  lge battery extending feature

config LGE_PM_CYCLE_BASED_WEIGHT
	bool "LGE battery cycle based weight feature"
	depends on LGE_PM
	depends on LGE_PM_CYCLE_BASED_CHG_VOLTAGE
	default n
	help
	  lge battery extending feature with cycle weight

config LGE_PM_USE_FAKE_BATT_TEMP_CTRL
	bool "Support Fake battery temp update"
	default n
	help
	  Say Y to enable support for the fake battery temperature update.

config LGE_PM_FACTORY_TESTMODE
	bool "Support factory testmode for AT Command"
	depends on LGE_PM
	default n
	help
	  Say Y to enable factory testmode in qpnp-smbcharger

config LGE_PM_WEAK_BATT_PACK
	bool "support for weak battery pack"
	default n
	depends on LGE_PM
	help
	  support for weak battery pack

config LGE_PM_STEP_CHARGING
	bool "Support step charging"
	depends on LGE_PM
	default n
	help
	  Say Y to enable step charging

config LGE_PM_CHARGERLOGO_WAIT_FOR_FG_INIT
	bool "Wait for FG init in LGE Chargerlogo"
	default n
	depends on LGE_PM_DEBUG
	depends on QPNP_FG_GEN3
	help
	  It is wait for FG init in LGE Chargerlogo.

config LGE_PM_INOV_GEN3_SYSFS_SUPPORT
	bool "INOV GEN3 Support for QCT Platform"
	default n
	depends on ARCH_MSM8998
	help
	  PMI8998 Temperature Sensor read interface at sysfs

config LGE_PM_CC_PROTECT
	bool "Support protect cc pin"
	depends on LGE_PM
	default n
	help
	  Say Y to enable protect cc pin.
endmenu
```

## drivers/soc/qcom/lge/Kconfig
```kconfig
config MACH_LGE
	bool "Machine LGE"
	help
	  Support for machine LGE.

menu "LGE Board Selection"

config MACH_MSM8998_TAIMEN
	bool "MSM8998 TAIMEN"
	depends on ARCH_MSM8998
	select MACH_LGE
	help
	  Support for the Qualcomm MSM8998 TAIMEN device.

config MACH_MSM8998_LUCY
	bool "MSM8998 LUCY"
	depends on ARCH_MSM8998
	select MACH_LGE
	help
	  Support for the Qualcomm MSM8998 LUCY device.

config MACH_MSM8998_LUCY_KR
	bool "MSM8998 LUCY_KR"
	depends on ARCH_MSM8998
	select MACH_LGE
	help
	  Support for the Qualcomm MSM8998 LUCY_KR device.

config MACH_MSM8998_LUCY_LGU_KR
	bool "MSM8998 LUCY_LGU_KR"
	depends on ARCH_MSM8998
	select MACH_LGE
	help
	  Support for the Qualcomm MSM8998 LUCY_LGU_KR device.

config MACH_MSM8998_LUCY_DCM_JP
	bool "MSM8998 LUCY_DCM_JP"
	depends on ARCH_MSM8998
	select MACH_LGE
	help
	  Support for the Qualcomm MSM8998 LUCY_DCM_JP device.

config MACH_MSM8998_JOAN
	bool "MSM8998 JOAN"
	depends on ARCH_MSM8998
	select MACH_LGE
	help
	  Support for the Qualcomm MSM8998 JOAN device.

config MACH_MSM8998_JOAN_KR
	bool "MSM8998 JOAN_KR"
	depends on ARCH_MSM8998
	select MACH_LGE
	help
	  Support for the Qualcomm MSM8998 JOAN_KR device.

config MACH_MSM8998_JOAN_LGU_KR
	bool "MSM8998 JOAN_LGU_KR"
	depends on ARCH_MSM8998
	select MACH_LGE
	help
	  Support for the Qualcomm MSM8998 JOAN_LGU_KR device.

config MACH_MSM8998_JOAN_SKT_KR
	bool "MSM8998 JOAN_SKT_KR"
	depends on ARCH_MSM8998
	select MACH_LGE
	help
	  Support for the Qualcomm MSM8998 JOAN_SKT_KR device.

config MACH_MSM8998_JOAN_KT_KR
	bool "MSM8998 JOAN_KT_KR"
	depends on ARCH_MSM8998
	select MACH_LGE
	help
	  Support for the Qualcomm MSM8998 JOAN_SKT_KR device.

config MACH_MSM8998_JOAN_VZW
	bool "MSM8998 JOAN_VZW"
	depends on ARCH_MSM8998
	select MACH_LGE
	help
	  Support for the Qualcomm MSM8998 JOAN_VZW device.

config MACH_MSM8998_JOAN_ATT_US
	bool "MSM8998 JOAN_ATT_US"
	depends on ARCH_MSM8998
	select MACH_LGE
	help
	  Support for the Qualcomm MSM8998 JOAN_ATT_US device.

config MACH_MSM8998_JOAN_SPR_US
	bool "MSM8998 JOAN_SPR_US"
	depends on ARCH_MSM8998
	select MACH_LGE
	help
	  Support for the Qualcomm MSM8998 JOAN_SPR_US device.


config MACH_MSM8998_JOAN_NAO_US
	bool "MSM8998 JOAN_NAO_US"
	depends on ARCH_MSM8998
	select MACH_LGE
	help
	  Support for the Qualcomm MSM8998 JOAN_NAO_US device.

config MACH_MSM8998_JOAN_TMO_US
	bool "MSM8998 JOAN_TMO_US"
	depends on ARCH_MSM8998
	select MACH_LGE
	help
	  Support for the Qualcomm MSM8998 JOAN_TMO_US device.

config MACH_MSM8998_JOAN_CLR_PR
	bool "MSM8998 JOAN_CLR_PR"
	depends on ARCH_MSM8998
	select MACH_LGE
	help
	  Support for the Qualcomm MSM8998 JOAN_CLR_PR device.


config MACH_MSM8998_JOAN_GLOBAL_COM
	bool "MSM8998 JOAN_GLOBAL_COM"
	depends on ARCH_MSM8998
	select MACH_LGE
	help
	  Support for the Qualcomm MSM8998 JOAN_GLOBAL_COM device.

config MACH_MSM8998_JOAN_GLOBAL_CA
	bool "MSM8998 JOAN_GLOBAL_CA"
	depends on ARCH_MSM8998
	select MACH_LGE
	help
	  Support for the Qualcomm MSM8998 JOAN_GLOBAL_CA device.

config MACH_MSM8998_JOAN_ACG_US
	bool "MSM8998 JOAN_ACG_US"
	depends on ARCH_MSM8998
	select MACH_LGE
	help
	  Support for the Qualcomm MSM8998 JOAN_ACG_US device.

config MACH_MSM8998_JOAN_DCM_JP
	bool "MSM8998 JOAN_DCM_JP"
	depends on ARCH_MSM8998
	select MACH_LGE
	help
	  Support for the Qualcomm MSM8998 JOAN_DCM_JP device.

config MACH_MSM8998_JOAN_GLOBAL_LDU
	bool "MSM8998 JOAN_GLOBAL_LDU"
	depends on ARCH_MSM8998
	select MACH_LGE
	help
	  Support for the Qualcomm MSM8998 JOAN_GLOBAL_LDU device.

config LGE_BOOTLOADER_LOG
	tristate "Support LGE bootloader log"
	default n
	depends on MACH_LGE
	help
	  LGE bootloader log

config LGE_BOOTLOADER_TIME_CHECKER
	tristate "Supprt bootloader(LK, SBL) time"
	default n
	depends on MACH_LGE
	help
	  Check LK, SBL booting time at
	  sys/module/lge_bootloader_time_checker/parameters/lk_time
	  sys/module/lge_bootloader_time_checker/parameters/sbl_time
endmenu

menu "LGE Specific Patches"

config LGE_HANDLE_PANIC
	tristate "Support LGE Crash Handler"
	default n
	depends on MACH_LGE
	help
	  LGE Crash Handler

config PRE_SELF_DIAGNOSIS
	tristate "Support LGE self diagnosis for factory"
	default n
	depends on MACH_LGE
	help
	  LGE self diagnosis

config LGE_PM_CHARGING_SCENARIO
	tristate "Support LGE PM Charging Scenario"
	default n
	depends on MACH_LGE
	help
	  LGE PM Charging Scenario

config LGE_PM_UNIFIED_NODE
	bool "enable LGE PM Unified sysfs node"
	default n
	depends on MACH_LGE
	help
	  Support LGE PM Unified sysfs node

config LGE_PM_SMPL_COUNTER
	tristate "Support LGE SMPL COUNTER feature"
	default n
	depends on MACH_LGE
	help
	  Say y to enable smpl_cnt module, that count when
	  booted by SMPL

config LGE_PM_TIME_TO_FULL
	tristate "Support LGE PM Time To Full"
	default n
	depends on LGE_PM
	help
	  LGE PM Time To Full

config LGE_QSDL_SUPPORT
	tristate "Support for Quality Statistics Data Logging"
	default n
	depends on MACH_LGE
	help
	  QSDL is a feature which notify infomation for quality statistics
	  data logging of device.

config LGE_MISC_PWR_CONTROLLER
       tristate "Support for controlling rails data for HW Team"
       default n
       depends on SPMI
       depends on MACH_LGE
       help
         MISC PWR controller is to modify some of the PMIC related registers.

config LGE_PKM
    tristate "Support PKM driver with QSEE"
    depends on MACH_LGE
    default n
    help
      Say Y here to enable Mobile Kernel Integrity driver for LG PKM

config LGE_PSTORE_BACKUP
	tristate "Support pstore backup"
	default n
	depends on MACH_LGE
	help
	  Ramoops region is backed up to pstore partition

endmenu

menu "LGE QFPROM Values"

config LGE_QFPROM_INTERFACE
	bool "Support qfprom interface"
	default n
	depends on MACH_LGE
	help
	  LGE QFPROM DRIVER.

config LGE_QFPROM_SECHASH
	string "Support qfprom sec hash"
	default 0x0
	depends on LGE_QFPROM_INTERFACE
	help
	  LGE QFPROM DRIVER-SEC partition's hash value.

config LGE_PM_UNIFIED_NODE
	bool "enable LGE PM Unified sysfs node"
	help
	  Support LGE PM Unified sysfs node

endmenu

source "drivers/soc/qcom/lge/power/Kconfig"
```

## drivers/usb/mausb-dev-host/Kconfig
```kconfig
config USB_MAUSB
	tristate "MAUSB support"
	depends on USB && NET
	default N
	---help---
	  This enables pushing USB packets over IP to allow remote
	  machines direct access to USB devices. It provides the
	  MAUSB core that is required by both drivers.

	  To compile this as a module, choose M here: the module will
	  be called mausb-core.

	  If unsure, say N.

config USB_MAUSB_DEVICE
	tristate "Device driver"
	depends on USB_MAUSB
	default N
	---help---
	  This enables the MAUSB Device driver, which is run on the
	  machine that is sharing the USB devices.

	  To compile this driver as a module, choose M here: the
	  module will be called mausb_device.

config USB_MAUSB_HCD
	tristate "Virtual HCD"
	depends on USB_MAUSB
	default N
	---help---
	  This enables the MAUSB virtual host controller driver,
	  which is run on the remote machine

	  To compile this as a module, choose M here: the module will
	  be called mausb-hcd.

config USB_MAUSB_DEBUG
	bool "Debug messages"
	depends on USB_MAUSB
	default N
	---help---
	  This enables the debug messages from the MAUSB drivers.
```
